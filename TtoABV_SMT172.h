/*
Needs math.h.
TtoLiquidABV converts �C to the liquid ABV in percent.
TCtoVaporABV converts �C to the vapor ABV in percent.
If the corrected temperature is lower then the azeotrope the negative index is returned
If the corrected temperature is higher than  100 �C  0 is returned

The array's of these functions are based on the Technical Paper 19 by
Herminio M. Brau dated April 1957.

Pressure influence is calculated with the Clausius Clapeyron relation.
For the liquid ABV the temperature is corrected with the change in boiling
point of water. At higher altitudes there will be some error for the high ABV values.
For the vapor ABV the temperature is corrected with the change in boiling
point of the azeotrope. At higher altitudes there will be some error
for the low ABV values.

This program is free software: you can redistribute it and/or modify
it under the terms of the version 3 GNU General Public License as
published by the Free Software Foundation.
Code by Edwin Croissant date 03dec15. */

#ifndef T2ABV_SMT172
#define T2ABV_SMT172
#include <avr/pgmspace.h>

float h2oBoilingPoint(float p) {
	// calculate the the boiling temperature of water for the measured pressure in Celsius
	float H2OInKelvin = -20330000 * 373.15
			/ (4157 * log(p / 1013.25) * 373.15 - 20330000);
	return H2OInKelvin - 273.15;
}

float azeotrope(float p) {
	// Calculate the the azeotrope for the measured pressure in Celsius
	float AzeotropeInKelvin = -19280000 * 351.324
			/ (4157 * log(p / 1013.25) * 351.324 - 19280000);
	return AzeotropeInKelvin - 273.15;
}


float correctedH2O(float T, float P) {
	return T + 100 - h2oBoilingPoint(P);
}

float correctedAzeo(float T, float P) {
	return T + 78.174 - azeotrope(P);
}

float TtoLiquidABV(float T) {
	const static uint8_t ABV[] PROGMEM = {
      /* by using PROGMEM the array stays in the program memory and is not copied to precious sram. */
		  198, 195, 192, 190, 188, 185, 183, 181, 179, 172, 169, 168, 168, 166, 165, 164, 162, 161, 160, 159,
		  158, 157, 155, 154, 153, 151, 150, 149, 148, 147, 146, 146, 145, 144, 143, 142, 139, 137, 136, 135,
		  134, 133, 132, 131, 130, 129, 127, 126, 125, 124, 124, 123, 122, 120, 119, 118, 117, 117, 116, 115,
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		    1,   1,   0};

	// Calculate the index for the table (7818 is the the azeotrope at 1013.25 hPa and the
	// starting point of the table) in �centiCelsius


	int16_t IndexABV = int16_t(T*100 + 0.5) - 7818;

	if (IndexABV < 0) return IndexABV; // Below azeotope
	if (IndexABV >= int16_t(sizeof ABV / sizeof *ABV)) return 0; // Above 100 �C
	if (IndexABV < 180) return float(pgm_read_byte(ABV + IndexABV) + 768) / 10;	//TODO pgm_read_byte(&ABV[IndexABV])
	if (IndexABV < 460)	return float(pgm_read_byte(ABV + IndexABV) + 512) / 10;
	if (IndexABV < 863)	return float(pgm_read_byte(ABV + IndexABV) + 256) / 10;
	return float(pgm_read_byte(ABV + IndexABV)) / 10;
};

float TtoVaporABV(float T) {
	const static uint8_t ABV[] PROGMEM = {
      /* by using PROGMEM the array stays in the program memory and is not copied to precious sram. */
		  199, 196, 193, 192, 190, 188, 186, 185, 183, 178, 176, 176, 176, 175, 174, 173, 172, 171, 171, 170,
		  169, 169, 168, 167, 166, 166, 165, 164, 164, 163, 162, 162, 162, 162, 161, 160, 159, 157, 157, 156,
		  156, 155, 154, 154, 153, 152, 152, 151, 151, 150, 150, 150, 149, 148, 148, 147, 147, 147, 146, 146,
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		    6,   3,   0};

	// Calculate the index for the table (7818 is the the azeotrope at 1013.25 hPa and the
	// starting point of the table) in �centiCelsius

	int16_t IndexABV = int16_t(T * 100 + 0.5) - 7818;

	if (IndexABV < 0) return IndexABV; // Below azeotope
	if (IndexABV >= int16_t(sizeof ABV / sizeof *ABV)) return 0; // Above 100 �C
	if (IndexABV <  712) return float(pgm_read_byte(ABV + IndexABV) + 768) / 10;
	if (IndexABV < 1598) return float(pgm_read_byte(ABV + IndexABV) + 512) / 10;
	if (IndexABV < 1963) return float(pgm_read_byte(ABV + IndexABV) + 256) / 10;
	return float(pgm_read_byte(ABV + IndexABV)) / 10;
};

#endif /* T2ABV_SMT172.h */
